## config/boards/shields/ycorne/Kconfig.shield
```kconfig
config SHIELD_YCORNE_LEFT
        def_bool $(shields_list_contains,ycorne_left)

config SHIELD_YCORNE_RIGHT
        def_bool $(shields_list_contains,ycorne_right)
```

## config/west.yml
```yaml
manifest:
  remotes:
    - name: zmkfirmware
      url-base: https://github.com/zmkfirmware
    - name: ypsilon
      url-base: https://github.com/ypsilon-takai
  projects:
    - name: zmk
      remote: ypsilon
      revision: main
      import: app/west.yml
  self:
    path: config
```
